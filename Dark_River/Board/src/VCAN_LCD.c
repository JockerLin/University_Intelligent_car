/*!
 *     COPYRIGHT NOTICE
 *     Copyright (c) 2013,山外科技
 *     All rights reserved.
 *     技术讨论：山外论坛 http://www.vcan123.com
 *
 *     除注明出处外，以下所有内容版权均属山外科技所有，未经允许，不得用于商业用途，
 *     修改内容时必须保留山外科技的版权声明。
 *
 * @file       VCAN_LCD.c
 * @brief      LCD 函数库
 * @author     山外科技
 * @version    v5.0
 * @date       2013-06-26
 */


#include "common.h"
#include "VCAN_LCD.h"
#include "include.h"

/*
#define LCD_DC	PTC19_OUT  //C19
#define LCD_RST	PTC18_OUT  //C18
#define LCD_SDA	PTC17_OUT  //C17
#define LCD_SCL	PTC16_OUT  //C16 
*/
#define LCD_DC	PTE27_OUT  //C19
#define LCD_RST	PTE28_OUT  //C18
#define LCD_SDA	PTA6_OUT  //C17
#define LCD_SCL	PTA7_OUT  //C16 



#define X_WIDTH 128
#define Y_WIDTH 64
typedef unsigned char byte;
typedef unsigned int word;
extern uint8 img[CAMERA_H][CAMERA_W];      //拓展定义图像存储函数img
void PID_Adjust(void);
extern int32 Left_Black[60],Right_Black[60];      //左边黑线存储数组
extern float Dir_detal,P_Direction_Control,D_Direction_Control,P_Direction_Control_now,D_Direction_Control_now;
extern int16 LB_Lose_Count_Last,RB_Lose_Count_Last;
void LCD_P6x8Str(byte x,byte y,byte ch[]);//显示字符串
void LCD_P14x16Str(byte x,byte y,byte ch[]);//显示汉子
void LCD_Print(byte x, byte y, byte ch[]);//显示汉字和字符
extern uint16 ML_Black_Spot_count,ML_White_Spot_count,O_Up_Blank_Point;
extern int16 O_LD_Flower_Black,O_RD_Flower_Black,O_LD_Flower_Up_Black,O_RD_Flower_Up_Black;

const byte F6x8[][6] =
{
    { 0x00, 0x00, 0x00, 0x00, 0x00, 0x00 },   // sp
    { 0x00, 0x00, 0x00, 0x2f, 0x00, 0x00 },   // !
    { 0x00, 0x00, 0x07, 0x00, 0x07, 0x00 },   // "
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    { 0x14, 0x14, 0x14, 0x14, 0x14, 0x14 }    // horiz lines
};
const byte F14x16_Idx[] = 
{
    "小鱻队灰灰直立车参数调试"
};
const byte F14x16[] = { 
  
0x08,0x84,0x7E,0x55,0xD5,0x55,0x7D,0xD7,0x55,0x54,0xFC,0x00,0x00,0x00,
0x21,0x1F,0x35,0x1F,0x35,0x1F,0x20,0x1F,0x35,0x1F,0x35,0x1F,0x20,0x00, //小鱻队
0x08,0x08,0x88,0xE8,0x9E,0x08,0x08,0xF8,0x08,0x88,0xC8,0x08,0x08,0x00,
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0x00,0x3F,0x10,0x08,0x10,0x10,0x1F,0x08,0x00,0x07,0x18,0x20,0x38,0x00,//试3
};


void LCD_WrDat(unsigned char data)  //读写数据
{
	unsigned char i=8;
	//LCD_CS=0;;
	LCD_DC=1;;
  LCD_SCL=0;;
  //asm("nop");    
  while(i--)
  {
    if(data&0x80){LCD_SDA=1;}
    else{LCD_SDA=0;}
    LCD_SCL=1; 
    asm("nop");;
		//asm("nop");            
    LCD_SCL=0;;    
    data<<=1;    
  }
	//LCD_CS=1;
}



void LCD_WrCmd(unsigned char cmd)  //
{
	unsigned char i=8;
	
	//LCD_CS=0;;
	LCD_DC=0;;
  LCD_SCL=0;;
  //asm("nop");   
  while(i--)
  {
    if(cmd&0x80){LCD_SDA=1;}
    else{LCD_SDA=0;;}
    LCD_SCL=1;;
    asm("nop");;
		//asm("nop");             
    LCD_SCL=0;;    
    cmd<<=1;;   
  } 	
	//LCD_CS=1;
}

void LCD_Fill(unsigned char bmp_data)
{
	unsigned char y,x;
	
	for(y=0;y<8;y++)
	{
		LCD_WrCmd(0xb0+y);
		LCD_WrCmd(0x01);
		LCD_WrCmd(0x10);
		for(x=0;x<X_WIDTH;x++)
			LCD_WrDat(bmp_data);
	}
}

void LCD_CLS(void) //清屏
{
	unsigned char y,x;	
	for(y=0;y<8;y++)
	{
		LCD_WrCmd(0xb0+y);
		LCD_WrCmd(0x01);
		LCD_WrCmd(0x10); 
		for(x=0;x<X_WIDTH;x++)
			LCD_WrDat(0);
	}
}
void LCD_Set_Pos(unsigned char x, unsigned char y) //画点
{ 
  LCD_WrCmd(0xb0+y);
  LCD_WrCmd(((x&0xf0)>>4)|0x10);
  LCD_WrCmd((x&0x0f)|0x01); 
}

void LCD_DLY_ms(unsigned int ms) //延时
{                         
  unsigned int a;
  while(ms)
  {
    a=1335;
    while(a--);
    ms--;
  }
  //delayms(ms);
  return;
}

void LCD_Init(void)        
{ 
    //-----端口初始化----//
    gpio_init (PTA6, GPO,0);
    gpio_init (PTA7, GPO,0);
    gpio_init (PTE28, GPO,0);
    gpio_init (PTE27, GPO,0);
      /*GPIO_Init(PORTC,16,GPO,0);
      GPIO_Init(PORTC,15,GPO,0);
      GPIO_Init(PORTC,14,GPO,0);
      GPIO_Init(PORTC,13,GPO,0);*/
      
  
	LCD_SCL=1;
	//LCD_CS=1;	//预制SLK和SS为高电平   	
	
	LCD_RST=0;
	LCD_DLY_ms(50);
	LCD_RST=1;

  LCD_WrCmd(0xae);//--turn off oled panel
  LCD_WrCmd(0x00);//---set low column address
  LCD_WrCmd(0x10);//---set high column address
  LCD_WrCmd(0x40);//--set start line address  Set Mapp.ing RAM Display Start Line (0x00~0x3F)
  LCD_WrCmd(0x81);//--set contrast control register
  LCD_WrCmd(0xcf); // Set SEG Output Current Brightness
  LCD_WrCmd(0xa1);//--Set SEG/Column Mapping     0xa0左右反置 0xa1正常
  LCD_WrCmd(0xc8);//Set COM/Row Scan Direction   0xc0上下反置 0xc8正常
  LCD_WrCmd(0xa6);//--set normal display
  LCD_WrCmd(0xa8);//--set multiplex ratio(1 to 64)
  LCD_WrCmd(0x3f);//--1/64 duty
  LCD_WrCmd(0xd3);//-set display offset	Shift Mapping RAM Counter (0x00~0x3F)
  LCD_WrCmd(0x00);//-not offset
  LCD_WrCmd(0xd5);//--set display clock divide ratio/oscillator frequency
  LCD_WrCmd(0x80);//--set divide ratio, Set Clock as 100 Frames/Sec
  LCD_WrCmd(0xd9);//--set pre-charge period
  LCD_WrCmd(0xf1);//Set Pre-Charge as 15 Clocks & Discharge as 1 Clock
  LCD_WrCmd(0xda);//--set com pins hardware configuration
  LCD_WrCmd(0x12);
  LCD_WrCmd(0xdb);//--set vcomh
  LCD_WrCmd(0x40);//Set VCOM Deselect Level
  LCD_WrCmd(0x20);//-Set Page Addressing Mode (0x00/0x01/0x02)
  LCD_WrCmd(0x02);//
  LCD_WrCmd(0x8d);//--set Charge Pump enable/disable
  LCD_WrCmd(0x14);//--set(0x10) disable
  LCD_WrCmd(0xa4);// Disable Entire Display On (0xa4/0xa5)
  LCD_WrCmd(0xa6);// Disable Inverse Display On (0xa6/a7) 
  LCD_WrCmd(0xaf);//--turn on oled panel
  LCD_Fill(0x00);  //初始清屏
  LCD_Set_Pos(0,0);  
	
} 

void Img_Printf_OLED()  //道路信息显示到OLED上
{
  //LCD_CLS();
  
  uint8 i = 0, j = 0,temp=0;
         /*
          for(j=0;j<80;j++)
          {
            img[15][j]=0x00;
          }
          
          for(j=0;j<80;j++)
          {
            img[30][j]=0x00;
          }
          
          for(j=0;j<80;j++)
          {
            img[45][j]=0x00;
          }
          for(i=0;i<60;i++)
          {
            img[i][20]=0x00;
          }
          for(i=0;i<60;i++)
          {
            img[i][40]=0x00;
          }
          for(i=0;i<60;i++)
          {
            img[i][60]=0x00;
          }
          */
  
          for(i=15;i<55;i++)//划左右边线
          {
            img[i][Left_Black[i]+2]=0x00;
            img[i][Right_Black[i]-2]=0x00;
            img[i][Left_Black[i]+3]=0x00;
            img[i][Right_Black[i]-3]=0x00;
            img[i][Left_Black[i]+4]=0x00;
            img[i][Right_Black[i]-4]=0x00;
          }
          
	for(i=0;i<64;i+=8)//6*8=48行 
	{
	  	LCD_Set_Pos(0,i/8);
	  	for(j=0;j<CAMERA_W;j++) 
	  	{ 
	  	  temp=0;
	  	  if(img[0+i][j]) temp|=0x01;
	  	  if(img[1+i][j]) temp|=0x02;
	  	  if(img[2+i][j]) temp|=0x04;
	  	  if(img[3+i][j]) temp|=0x08;
	  	  if(img[4+i][j]) temp|=0x10;
	  	  if(img[5+i][j]) temp|=0x20;
	  	  if(img[6+i][j]) temp|=0x40;
	  	  if(img[7+i][j]) temp|=0x80;
	  	  LCD_WrDat(temp); 	  	  	  	  
	  	}
	}
        
          
        //Dir_detal_Show=Dir_detal*1000/1000;
        //LCD_PrintU16(80,5,(int16)Dir_detal_Show);
        LCD_Print(80,0,"Detal");
        DisplayFloat((int32)(Dir_detal*1000),80,1);//方向偏差
        LCD_Print(80,2,"LL");
        DisplayFloat((int32)(O_LD_Flower_Up_Black*1000),80,3);
        LCD_Print(80,4,"RL");
        DisplayFloat((int32)(O_RD_Flower_Up_Black*1000),80,5);
        LCD_Print(80,6,"hei");
        DisplayFloat(O_Up_Blank_Point*1000,80,7);
}

//==============================================================
//函数名：LCD_P6x8Str(byte x,byte y,byte *p)
//功能描述：写入一组标准ASCII字符串
//参数：显示的位置（x,y），y为页范围0～7，要显示的字符串
//返回：无
//==============================================================  
void LCD_P6x8Str(byte x,byte y,byte ch[])
{
  byte c=0,i=0,j=0;      
  while (ch[j]!='\0')
  {    
    c =ch[j]-32;
    if(x>126){x=0;y++;}
    LCD_Set_Pos(x,y);    
  	for(i=0;i<6;i++)     
  	  LCD_WrDat(F6x8[c][i]);  
  	x+=6;
  	j++;
  }
}
//输出汉字字符串
void LCD_P14x16Str(byte x,byte y,byte ch[])
{
	byte wm=0,ii = 0;
	word adder=1; 
	
	while(ch[ii] != '\0')
	{
  	wm = 0;
  	adder = 1;
  	while(F14x16_Idx[wm] > 127)
  	{
  		if(F14x16_Idx[wm] == ch[ii])
  		{
  			if(F14x16_Idx[wm + 1] == ch[ii + 1])
  			{
  				adder = wm * 14;
  				break;
  			}
  		}
  		wm += 2;			
  	}
  	if(x>118){x=0;y++;}
  	LCD_Set_Pos(x , y); 
  	if(adder != 1)// 显示汉字					
  	{
  		LCD_Set_Pos(x , y);
  		for(wm = 0;wm < 14;wm++)               
  		{
  			LCD_WrDat(F14x16[adder]);	
  			adder += 1;
  		}      
  		LCD_Set_Pos(x,y + 1); 
  		for(wm = 0;wm < 14;wm++)          
  		{
  			LCD_WrDat(F14x16[adder]);
  			adder += 1;
  		}   		
  	}
  	else			  //显示空白字符			
  	{
  		ii += 1;
      LCD_Set_Pos(x,y);
  		for(wm = 0;wm < 16;wm++)
  		{
  				LCD_WrDat(0);
  		}
  		LCD_Set_Pos(x,y + 1);
  		for(wm = 0;wm < 16;wm++)
  		{   		
  				LCD_WrDat(0);	
  		}
  	}
  	x += 14;
  	ii += 2;
	}
}
//输出汉字和字符混合字符串
void LCD_Print(byte x, byte y, byte ch[])
{
	byte ch2[3];
	byte ii=0;        
	while(ch[ii] != '\0')
	{
		if(ch[ii] > 127)
		{
			ch2[0] = ch[ii];
	 		ch2[1] = ch[ii + 1];
			ch2[2] = '\0';			//汉字为两个字节
			LCD_P14x16Str(x , y, ch2);	//显示汉字
			x += 14;
			ii += 2;
		}
		else
		{
			ch2[0] = ch[ii];	
			ch2[1] = '\0';			//字母占一个字节
			//LCD_P8x16Str(x , y , ch2);	//显示字母
                        LCD_P6x8Str(x , y , ch2);
			x += 8;
			ii+= 1;
		}
	}
}
void DisplayFloat(int i,uint8 x,uint8 y)
{
      int8 a[7]={0}; 
      if(i<0)
      {
        a[0]='-';
        i=-i;
      }
      else
      a[0]='+';
      
      a[1]=i/10000;
      a[2]=i%10000/1000;
      a[3]='.';
      a[4]=i%1000/100;
      a[5]=i%100/10;
      a[6]=i%10;
      for(uint8 j=0;j<7;j++)
      {
         switch(a[j])
         {
           case 0:{LCD_P6x8Str(x,y,"0");}break;
           case 1:{LCD_P6x8Str(x,y,"1");}break;
           case 2:{LCD_P6x8Str(x,y,"2");}break;
           case 3:{LCD_P6x8Str(x,y,"3");}break;
           case 4:{LCD_P6x8Str(x,y,"4");}break;
           case 5:{LCD_P6x8Str(x,y,"5");}break;
           case 6:{LCD_P6x8Str(x,y,"6");}break;
           case 7:{LCD_P6x8Str(x,y,"7");}break;
           case 8:{LCD_P6x8Str(x,y,"8");}break;
           case 9:{LCD_P6x8Str(x,y,"9");}break; 
         case '-':{LCD_P6x8Str(x,y,"-");}break;
         case '+':{LCD_P6x8Str(x,y,"+");}break;
         case '.':{LCD_P6x8Str(x,y,".");}break;
           default:break;
          }
         x+=6;
         if(x==90)
           x=20;
         }
}

void LCD_PrintU16(unsigned char x,unsigned char y,unsigned int num)
{
	unsigned char tmp[6],i;
	tmp[5]=0;
	tmp[4]=(unsigned char)(num%10+0x30);
	tmp[3]=(unsigned char)(num/10%10+0x30);
	tmp[2]=(unsigned char)(num/100%10+0x30);
	tmp[1]=(unsigned char)(num/1000%10+0x30);
	tmp[0]=(unsigned char)(num/10000%10+0x30);
	
	for(i=0;i<4;i++)
	{
		if(tmp[i]=='0')
			tmp[i]=' ';
		else
			break;
	}
	
	LCD_P6x8Str(x,y,tmp);
}



